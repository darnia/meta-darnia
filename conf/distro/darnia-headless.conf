## conf/distro/darnia-headless.conf
```bitbake
# Distribution definition for: darnia

require conf/distro/poky.conf
require conf/distro/darnia.inc

DISTRO = "darnia-headless"
DISTROOVERRIDES = "poky:darnia-headless"
TCLIBC = "glibc"
#TCLIBC = "uclibc"
```

## conf/distro/darnia.conf
```bitbake
# Distribution definition for: darnia

require conf/distro/poky.conf
require conf/distro/darnia.inc

DISTRO = "darnia"
DISTROOVERRIDES = "poky:darnia"
TCLIBC = "glibc"
#TCLIBC = "uclibc"

DISTRO_FEATURES += " opengl qt5"

PREFERRED_PROVIDER_virtual/egl      ?= "mesa"
PREFERRED_PROVIDER_virtual/libgl    ?= "mesa"
PREFERRED_PROVIDER_virtual/libgles1 ?= "mesa"
PREFERRED_PROVIDER_virtual/libgles2 ?= "mesa"
```

## conf/distro/darnia.inc
```bitbake
# Distribution definition for: darnia

# Distro config is evaluated after the machine config, so we have to explicitly
# set the kernel provider to override a machine config.
PREFERRED_PROVIDER_virtual/kernel ?= "linux-stable"
PREFERRED_VERSION_linux-stable ?= "5.4%"

# Comment out any of the lines below to disable them in the build
# DISTRO_FEATURES options:
# alsa bluetooth ext2 pcmcia usbgadget usbhost wifi nfs zeroconf pci
DISTRO_FEATURES_GENERAL = "ext2 pci systemd"
DISTRO_FEATURES_NET = "ipv4 ipv6"
DISTRO_FEATURES_USB = "usbhost"
DISTRO_FEATURES_USBGADGET = "usbgadget"
DISTRO_FEATURES_WIFI = "wifi"
DISTRO_FEATURES_WIRED = "wired"
#DISTRO_FEATURES_BLUETOOTH = "bluetooth"

DISTRO_FEATURES = "${DISTRO_FEATURES_GENERAL} \
                   ${DISTRO_FEATURES_BLUETOOTH} \
                   ${DISTRO_FEATURES_NET} \
                   ${DISTRO_FEATURES_USB} \
                   ${DISTRO_FEATURES_USBGADGET} \
                   ${DISTRO_FEATURES_WIFI} \
                   ${DISTRO_FEATURES_WIRED} \
                   ${DISTRO_FEATURES_LIBC} \
                  "

# Enable LFS - see bug YOCTO #5865
DISTRO_FEATURES_append_libc-uclibc = " largefile"
DISTRO_FEATURES_append_libc-musl = " largefile"

DISTRO_FEATURES_class-native = "${DISTRO_FEATURES_DEFAULT} ${POKY_DEFAULT_DISTRO_FEATURES}"
DISTRO_FEATURES_class-nativesdk = "${DISTRO_FEATURES_DEFAULT} ${POKY_DEFAULT_DISTRO_FEATURES}"

# enable systemd for init
INIT_MANAGER ?= "systemd"
VIRTUAL-RUNTIME_init_manager = "systemd"
VIRTUAL-RUNTIME_initscripts = "systemd-compat-units"

IMAGE_FSTYPES = "ext4"

QB_DEFAULT_FSTYPE = "${IMAGE_FSTYPES}"

#
#PREFERRED_PROVIDER_jpeg = "libjpeg-turbo"
#PREFERRED_PROVIDER_jpeg-native = "libjpeg-turbo-native"

# Disable python usage in opkg-utils since it won't build with tiny config
PACKAGECONFIG_remove_pn-opkg-utils = "python"

# 
PACKAGECONFIG_remove_pn-systemd = " networkd timesyncd"

# 
PACKAGECONFIG_append_pn-coreutils = " \
    single-binary \
"

DISTRO_FEATURES_BACKFILL_CONSIDERED += "pulseaudio"
DISTRO_FEATURES_BACKFILL_CONSIDERED += "sysvinit"
```

## conf/layer.conf
```bitbake
# We have a conf and classes directory, append to BBPATH
BBPATH .= ":${LAYERDIR}"

# We have a recipes directory, add to BBFILES
BBFILES += " \
    ${LAYERDIR}/recipes-*/*/*.bb \
    ${LAYERDIR}/recipes-*/*/*.bbappend \
    ${LAYERDIR}/images/*.bb \
"

BBFILE_COLLECTIONS += "meta-darnia"
BBFILE_PATTERN_meta-darnia := "^${LAYERDIR}/"
BBFILE_PRIORITY_meta-darnia = "6"

LAYERSERIES_COMPAT_meta-darnia = "warrior zeus"
```

## conf/machine/bpi-m2-zero.conf
```bitbake
#@TYPE: Machine
#@NAME: bpi-m2-zero
#@DESCRIPTION: Machine configuration for the banana pi m2 zero, base on allwinner H2+ (H3) CPU

require conf/machine/include/sun8i.inc

MACHINE_FEATURES += "wifi bluetooth ext2 vfat"

KERNEL_DEVICETREE = "sun8i-h2-plus-bananapi-m2-zero.dtb"
UBOOT_MACHINE = "bananapi_m2_zero_defconfig"

WKS_FILE = "orange-pi.wks"

# WiFi AP6212 firmware
IMAGE_INSTALL += "ap6212-firmware"

IMAGE_BOOT_FILES = "boot.scr zImage sun8i-h2-plus-bananapi-m2-zero.dtb"

DEFAULTTUNE = "cortexa7hf-neon-vfpv4"
```

## conf/machine/include/sunxi64.inc
```bitbake
SOC_FAMILY ??= ""
include conf/machine/include/soc-family.inc

PREFERRED_PROVIDER_virtual/kernel ?= "linux-stable"
PREFERRED_PROVIDER_u-boot ?= "u-boot-opi"
PREFERRED_PROVIDER_virtual/bootloader ?= "u-boot-opi"

KERNEL_IMAGETYPE ?= "Image"

IMAGE_FSTYPES += "ext4 tar.gz"

MACHINE_EXTRA_RRECOMMENDS = "kernel-modules"

UBOOT_LOCALVERSION = "-g${@d.getVar('SRCPV', True).partition('+')[2][0:7]}"

UBOOT_ENTRYPOINT ?= "0x40008000"
UBOOT_LOADADDRESS ?= "0x400080OB00"

UBOOT_BINARY = "u-boot.itb"
SPL_BINARY = "spl/sunxi-spl.bin"

SERIAL_CONSOLE ?= "115200 ttyS0"
MACHINE_FEATURES ?= "alsa apm keyboard rtc serial screen usbgadget usbhost vfat"
```

## conf/machine/opi-r1.conf
```bitbake
#@TYPE: Machine
#@NAME: orange-pi-r1
#@DESCRIPTION: Machine configuration for the orange-pi-r1, base on allwinner H2+ (H3) CPU

require conf/machine/include/sun8i.inc

MACHINE_FEATURES += "wifi ext2 vfat"

KERNEL_DEVICETREE = "sun8i-h2-plus-orangepi-r1.dtb"
UBOOT_MACHINE = "orangepi_r1_defconfig"

WKS_FILE = "orange-pi.wks"

IMAGE_INSTALL += "rtl8189es linux-firmware-rtl8189es"
IMAGE_BOOT_FILES = "boot.scr zImage sun8i-h2-plus-orangepi-r1.dtb u-boot-sunxi-with-spl.bin"

DEFAULTTUNE = "cortexa7hf-neon-vfpv4"
```

## conf/machine/opi0.conf
```bitbake
#@TYPE: Machine
#@NAME: orange-pi-zero
#@DESCRIPTION: Machine configuration for the orange-pi-zero, base on allwinner H2+ (H3) CPU

require conf/machine/include/sun8i.inc

MACHINE_FEATURES += "wifi ext2 vfat"

KERNEL_DEVICETREE = "sun8i-h2-plus-orangepi-zero.dtb"
UBOOT_MACHINE = "orangepi_zero_defconfig"

WKS_FILE = "orange-pi.wks"

IMAGE_INSTALL += "xradio xradio-firmware"
IMAGE_BOOT_FILES = "boot.scr zImage sun8i-h2-plus-orangepi-zero.dtb u-boot-sunxi-with-spl.bin"

DEFAULTTUNE = "cortexa7hf-neon-vfpv4"
```

## conf/machine/opi0p2h3.conf
```bitbake
#@TYPE: Machine
#@NAME: opi0p2h3
#@DESCRIPTION: Machine configuration for the orange pi zero plus2, base on allwinner H3 CPU

require conf/machine/include/sun8i.inc

MACHINE_FEATURES += "wifi ext2 vfat"

KERNEL_DEVICETREE = "sun8i-h3-orangepi-zero-plus2.dtb"
UBOOT_MACHINE = "orangepi_zero_plus2_h3_defconfig"

WKS_FILE = "orange-pi.wks"

PACKAGECONFIG_append_pn-mesa = "gallium lima kmsro"
IMAGE_INSTALL += " ap6212-firmware mesa kmscube glmark2"
IMAGE_BOOT_FILES = "boot.scr zImage sun8i-h3-orangepi-zero-plus2.dtb u-boot-sunxi-with-spl.bin"

DEFAULTTUNE = "cortexa7hf-neon-vfpv4"
```

## conf/machine/tx6.conf
```bitbake
#@TYPE: Machine
#@NAME: Tanix tx6 
#@DESCRIPTION: Machine configuration for the Tanix tx6, base on allwinner H6 CPU

require conf/machine/include/sun50i.inc

MACHINE_FEATURES += "wifi ext2 vfat"

KERNEL_DEVICETREE = "allwinner/sun50i-h6-tanix-tx6.dtb"
UBOOT_MACHINE = "tx6_defconfig"

WKS_FILE = "sun50i.wks"

PACKAGECONFIG_append_pn-mesa = "gbm dri opengl egl gallium panfrost kmsro"

IMAGE_INSTALL += " mesa kmscube glmark2"
IMAGE_BOOT_FILES = "boot.scr Image sun50i-h6-tanix-tx6.dtb;allwinner/sun50i-h6-tanix-tx6.dtb"
```

## conf/machine/tx6m.conf
```bitbake
#@TYPE: Machine
#@NAME: Tanix tx6 mini
#@DESCRIPTION: Machine configuration for the Tanix tx6 mini, base on allwinner H6 CPU

require conf/machine/include/sun50i.inc

MACHINE_FEATURES += "wifi ext2 vfat"

KERNEL_DEVICETREE = "allwinner/sun50i-h6-tanix-tx6-mini.dtb"
UBOOT_MACHINE = "tx6m_defconfig"

WKS_FILE = "sun50i.wks"

PACKAGECONFIG_append_pn-mesa = "gbm dri opengl egl gallium panfrost kmsro"

#IMAGE_INSTALL += "xradio xradio-firmware"
IMAGE_INSTALL += " mesa kmscube glmark2"
IMAGE_BOOT_FILES = "boot.scr Image sun50i-h6-tanix-tx6-mini.dtb;allwinner/sun50i-h6-tanix-tx6-mini.dtb"
```

## recipes-bsp/u-boot-opi/u-boot-opi/tx6_defconfig
```kconfig
CONFIG_ARM=y
CONFIG_ARCH_SUNXI=y
CONFIG_NR_DRAM_BANKS=1
CONFIG_SPL=y
CONFIG_MACH_SUN50I_H6=y
CONFIG_DRAM_CLK=648
CONFIG_DRAM_ZQ=3881979
CONFIG_SUNXI_DRAM_H6_DDR3_1333=y
CONFIG_MMC0_CD_PIN="PF6"
CONFIG_MMC_SUNXI_SLOT_EXTRA=2
# CONFIG_PSCI_RESET is not set
# CONFIG_SYS_MALLOC_CLEAR_ON_INIT is not set
CONFIG_USE_PREBOOT=y
# CONFIG_SPL_DOS_PARTITION is not set
CONFIG_DEFAULT_DEVICE_TREE="sun50i-h6-tanix-tx6"
CONFIG_SYS_RELOC_GD_ENV_ADDR=y
#CONFIG_USB_EHCI_HCD=y
#CONFIG_USB_OHCI_HCD=y
CONFIG_DM_VIDEO=y
CONFIG_VIDEO_BPP32=y
CONFIG_DISPLAY=y
CONFIG_I2C_EDID=y
# CONFIG_SPL_EFI_PARTITION is not set
CONFIG_DISTRO_DEFAULTS=y
CONFIG_CMD_UNZIP=y
CONFIG_ENV_SIZE=0x4000
CONFIG_ENV_FAT_INTERFACE="mmc"
CONFIG_ENV_FAT_DEVICE_AND_PART="0:1"
CONFIG_ENV_VARS_UBOOT_RUNTIME_CONFIG=y
```
