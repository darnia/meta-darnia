## recipes-kernel/linux/linux-stable-5.4/bpi-m2-zero/defconfig
```kconfig
CONFIG_NO_HZ=y
CONFIG_HIGH_RES_TIMERS=y
CONFIG_CGROUPS=y
CONFIG_BLK_DEV_INITRD=y
CONFIG_PERF_EVENTS=y
CONFIG_MODULES=y
CONFIG_MODULE_UNLOAD=y
CONFIG_ARCH_SUNXI=y
CONFIG_SMP=y
CONFIG_NR_CPUS=8
CONFIG_AEABI=y
CONFIG_HIGHMEM=y
CONFIG_CMA=y
CONFIG_ARM_APPENDED_DTB=y
CONFIG_ARM_ATAG_DTB_COMPAT=y
CONFIG_CPU_FREQ=y
CONFIG_CPUFREQ_DT=y
CONFIG_VFP=y
CONFIG_NEON=y
CONFIG_NET=y
CONFIG_PACKET=y
CONFIG_UNIX=y
CONFIG_INET=y
CONFIG_IP_PNP=y
CONFIG_IP_PNP_DHCP=y
CONFIG_IP_PNP_BOOTP=y
# CONFIG_INET_XFRM_MODE_TRANSPORT is not set
# CONFIG_INET_XFRM_MODE_TUNNEL is not set
# CONFIG_INET_XFRM_MODE_BEET is not set
# CONFIG_INET_DIAG is not set
CONFIG_IPV6=y
CONFIG_CAN=y
CONFIG_CAN_SUN4I=y
# CONFIG_WIRELESS is not set
CONFIG_DEVTMPFS=y
CONFIG_DEVTMPFS_MOUNT=y
CONFIG_DMA_CMA=y
CONFIG_BLK_DEV_SD=y
CONFIG_ATA=y
CONFIG_AHCI_SUNXI=y
CONFIG_NETDEVICES=y
CONFIG_SUN4I_EMAC=y
CONFIG_AUTOFS4_FS=y
# CONFIG_NET_VENDOR_ARC is not set
# CONFIG_NET_CADENCE is not set
# CONFIG_NET_VENDOR_BROADCOM is not set
# CONFIG_NET_VENDOR_CIRRUS is not set
# CONFIG_NET_VENDOR_FARADAY is not set
# CONFIG_NET_VENDOR_INTEL is not set
# CONFIG_NET_VENDOR_MARVELL is not set
# CONFIG_NET_VENDOR_MICREL is not set
# CONFIG_NET_VENDOR_MICROCHIP is not set
# CONFIG_NET_VENDOR_NATSEMI is not set
# CONFIG_NET_VENDOR_SAMSUNG is not set
# CONFIG_NET_VENDOR_SEEQ is not set
# CONFIG_NET_VENDOR_SMSC is not set
CONFIG_STMMAC_ETH=y
CONFIG_STMMAC_PLATFORM=y  
CONFIG_DWMAC_GENERIC=y    
CONFIG_DWMAC_SUNXI=y      
CONFIG_DWMAC_SUN8I=y      
# CONFIG_NET_VENDOR_VIA is not set
# CONFIG_NET_VENDOR_WIZNET is not set
# CONFIG_WLAN is not set
CONFIG_INPUT_EVDEV=y
CONFIG_KEYBOARD_SUN4I_LRADC=y
# CONFIG_INPUT_MOUSE is not set
CONFIG_INPUT_TOUCHSCREEN=y
CONFIG_TOUCHSCREEN_SUN4I=y
CONFIG_INPUT_MISC=y
CONFIG_INPUT_AXP20X_PEK=y
CONFIG_SERIAL_8250=y
CONFIG_SERIAL_8250_CONSOLE=y
CONFIG_SERIAL_8250_NR_UARTS=8
CONFIG_SERIAL_8250_RUNTIME_UARTS=8
CONFIG_SERIAL_8250_DW=y
CONFIG_SERIAL_OF_PLATFORM=y
# CONFIG_HW_RANDOM is not set
CONFIG_I2C_CHARDEV=y
CONFIG_I2C_MV64XXX=y
CONFIG_I2C_SUN6I_P2WI=y
CONFIG_SPI=y
CONFIG_SPI_SUN4I=y
CONFIG_SPI_SUN6I=y
CONFIG_GPIO_SYSFS=y
CONFIG_POWER_SUPPLY=y
CONFIG_CHARGER_AXP20X=y
CONFIG_BATTERY_AXP20X=y
CONFIG_AXP20X_POWER=y
CONFIG_THERMAL=y
CONFIG_CPU_THERMAL=y
CONFIG_WATCHDOG=y
CONFIG_SUNXI_WATCHDOG=y
CONFIG_MFD_AC100=y
CONFIG_MFD_AXP20X_I2C=y
CONFIG_MFD_AXP20X_RSB=y
CONFIG_REGULATOR=y
CONFIG_REGULATOR_FIXED_VOLTAGE=y
CONFIG_REGULATOR_AXP20X=y
CONFIG_REGULATOR_GPIO=y
CONFIG_MEDIA_SUPPORT=y
CONFIG_RC_CORE=y
CONFIG_RC_DEVICES=y
CONFIG_IR_SUNXI=y
CONFIG_DRM=y
CONFIG_DRM_SUN4I=y
CONFIG_DRM_DUMB_VGA_DAC=y
CONFIG_FB_SIMPLE=y
CONFIG_SOUND=y
CONFIG_SND=y
CONFIG_SND_SOC=y
CONFIG_SND_SUN4I_CODEC=y
CONFIG_USB=y
CONFIG_USB_EHCI_HCD=y
CONFIG_USB_EHCI_HCD_PLATFORM=y
CONFIG_USB_OHCI_HCD=y
CONFIG_USB_OHCI_HCD_PLATFORM=y
CONFIG_USB_MUSB_HDRC=y
CONFIG_USB_MUSB_SUNXI=y
CONFIG_NOP_USB_XCEIV=y
CONFIG_USB_GADGET=y
CONFIG_MMC=y
CONFIG_MMC_SUNXI=y
CONFIG_NEW_LEDS=y
CONFIG_LEDS_CLASS=y
CONFIG_LEDS_GPIO=y
CONFIG_LEDS_TRIGGERS=y
CONFIG_LEDS_TRIGGER_HEARTBEAT=y
CONFIG_LEDS_TRIGGER_DEFAULT_ON=y
CONFIG_RTC_CLASS=y
# CONFIG_RTC_INTF_SYSFS is not set
# CONFIG_RTC_INTF_PROC is not set
CONFIG_RTC_DRV_AC100=y
CONFIG_RTC_DRV_SUNXI=y
CONFIG_DMADEVICES=y
CONFIG_DMA_SUN6I=y
# CONFIG_IOMMU_SUPPORT is not set
CONFIG_EXTCON=y
CONFIG_IIO=y
CONFIG_AXP20X_ADC=y
CONFIG_PWM=y
CONFIG_PWM_SUN4I=y
CONFIG_PHY_SUN4I_USB=y
CONFIG_PHY_SUN9I_USB=y
CONFIG_NVMEM=y
CONFIG_NVMEM_SUNXI_SID=y
CONFIG_EXT4_FS=y
CONFIG_VFAT_FS=y
CONFIG_TMPFS=y
CONFIG_NFS_FS=y
CONFIG_NFS_V3_ACL=y
CONFIG_NFS_V4=y
CONFIG_ROOT_NFS=y
CONFIG_NLS_CODEPAGE_437=y
CONFIG_NLS_ISO8859_1=y
CONFIG_PRINTK_TIME=y
CONFIG_DEBUG_FS=y
CONFIG_CRYPTO_DEV_SUN4I_SS=y
CONFIG_ARM_CRYPTO=y
CONFIG_CRYPTO_SHA1_ARM_NEON=y
CONFIG_CRYPTO_SHA256_ARM=y
CONFIG_CRYPTO_SHA512_ARM_NEON=y
CONFIG_CRYPTO_AES_ARM_BS=y
#
# WiFI                                                
#
CONFIG_WIRELESS=y                                     
CONFIG_WEXT_CORE=y                                    
CONFIG_WEXT_PROC=y                                    
CONFIG_CFG80211=m                                     
# CONFIG_NL80211_TESTMODE is not set                  
# CONFIG_CFG80211_DEVELOPER_WARNINGS is not set       
CONFIG_CFG80211_DEFAULT_PS=y                          
# CONFIG_CFG80211_DEBUGFS is not set                  
# CONFIG_CFG80211_INTERNAL_REGDB is not set           
CONFIG_CFG80211_CRDA_SUPPORT=y                        
CONFIG_CFG80211_WEXT=y                                
# CONFIG_LIB80211 is not set                          
CONFIG_MAC80211=m                                     
CONFIG_MAC80211_HAS_RC=y                              
CONFIG_MAC80211_RC_MINSTREL=y                         
CONFIG_MAC80211_RC_MINSTREL_HT=y
# CONFIG_MAC80211_RC_MINSTREL_VHT is not set
CONFIG_MAC80211_RC_DEFAULT_MINSTREL=y
CONFIG_MAC80211_RC_DEFAULT="minstrel_ht"
# CONFIG_MAC80211_MESH is not set
# CONFIG_MAC80211_LEDS is not set         
# CONFIG_MAC80211_DEBUGFS is not set
# CONFIG_MAC80211_MESSAGE_TRACING is not set
# CONFIG_MAC80211_DEBUG_MENU is not set
CONFIG_MAC80211_STA_HASH_MAX_SIZE=0
# CONFIG_WIMAX is not set                 
CONFIG_RFKILL=m     
CONFIG_RFKILL_LEDS=y                      
CONFIG_RFKILL_INPUT=y 
CONFIG_RFKILL_GPIO=m                      
# CONFIG_NET_9P is not set      
# CONFIG_CAIF is not set         
# CONFIG_CEPH_LIB is not set  
# CONFIG_NFC is not set                   
# CONFIG_PSAMPLE is not set    
# CONFIG_NET_IFE is not set  
# CONFIG_LWTUNNEL is not set
# CONFIG_DST_CACHE is not set
# CONFIG_GRO_CELLS is not set                         
# CONFIG_NET_DEVLINK is not set                       
CONFIG_MAY_USE_DEVLINK=y
CONFIG_HAVE_EBPF_JIT=y    
#
# Wifi ap6212 driver
#
CONFIG_WLAN=y
CONFIG_WLAN_VENDOR_BROADCOM=y
CONFIG_BRCMUTIL=m
CONFIG_BRCMFMAC=m
CONFIG_BRCMFMAC_PROTO_BCDC=y
CONFIG_BRCMFMAC_SDIO=y
CONFIG_BRCMFMAC_USB=y 
# CONFIG_BRCMDBG is not set
CONFIG_HOSTAP=m
CONFIG_HOSTAP_FIRMWARE=y
# Wifi AP
CONFIG_DRIVER_HOSTAP=y
CONFIG_DRIVER_NL80211=y
CONFIG_LIBNL32=y
CONFIG_IAPP=y
CONFIG_RSN_PREAUTH=y
CONFIG_IEEE80211W=y
CONFIG_EAP=y
CONFIG_ERP=y
CONFIG_EAP_MD5=y
CONFIG_EAP_TLS=y
CONFIG_EAP_MSCHAPV2=y
CONFIG_EAP_PEAP=y
CONFIG_EAP_GTC=y
CONFIG_EAP_TTLS=y
CONFIG_EAP_SIM=y
CONFIG_EAP_AKA=y
CONFIG_EAP_AKA_PRIME=y
CONFIG_EAP_PWD=y
CONFIG_WPS=y
CONFIG_PKCS12=y
CONFIG_RADIUS_SERVER=y
CONFIG_IPV6=y
CONFIG_IEEE80211R=y
CONFIG_IEEE80211N=y
CONFIG_WNM=y
CONFIG_IEEE80211AC=y
CONFIG_IEEE80211AX=y
CONFIG_NO_VLAN=y
CONFIG_INTERWORKING=y
CONFIG_HS20=y
CONFIG_FILS=y
CONFIG_FILS_SK_PFS=y
CONFIG_OCV=y
CONFIG_OWE=y
CONFIG_DPP=y
CONFIG_SAE=y
#
# Enable display engine 
#
CONFIG_DRM_SUN8I_DW_HDMI=y          
CONFIG_DRM_SUN4I_HDMI=y             
CONFIG_DRM_SUN4I_HDMI_CEC=y         
CONFIG_DRM_SUN4I_BACKEND=y         
CONFIG_DRM_SUN8I_MIXER=y
CONFIG_DRM_SUN8I_TCON_TOP=y
CONFIG_SUN8I_DE2_CCU=y         
CONFIG_SND_SUN8I_CODEC_ANALOG=y
CONFIG_DRM_FBDEV_EMULATION=y
CONFIG_DRM_FBDEV_OVERALLOC=300
CONFIG_MALI400=y                        
CONFIG_MALI400_DEBUG=y    
CONFIG_MALI400_UMP=y
# CONFIG_MALI_DVFS is not set
CONFIG_DRM_MALI=y  
#
# Bluetooth   
#                            
CONFIG_BT=m         
CONFIG_BT_BREDR=y                         
CONFIG_BT_RFCOMM=m  
CONFIG_BT_RFCOMM_TTY=y
CONFIG_BT_BNEP=m                
CONFIG_BT_BNEP_MC_FILTER=y       
CONFIG_BT_BNEP_PROTO_FILTER=y 
CONFIG_BT_HIDP=m                          
CONFIG_BT_HS=y                 
CONFIG_BT_LE=y               
CONFIG_BT_6LOWPAN=m 
CONFIG_BT_LEDS=y    
CONFIG_BT_DEBUGFS=y                       
#
# Bluetooth device drivers
#
CONFIG_BT_INTEL=m
CONFIG_BT_BCM=m
CONFIG_BT_RTL=m
CONFIG_BT_HCIBTUSB=m
# CONFIG_BT_HCIBTUSB_AUTOSUSPEND is not set
CONFIG_BT_HCIBTUSB_BCM=y
CONFIG_BT_HCIBTUSB_RTL=y
# CONFIG_BT_HCIBTSDIO is not set
CONFIG_BT_HCIUART=m
CONFIG_BT_HCIUART_H4=y
CONFIG_BT_HCIUART_BCSP=y
# CONFIG_BT_HCIUART_ATH3K is not set
# CONFIG_BT_HCIUART_INTEL is not set
# CONFIG_BT_HCIUART_AG6XX is not set
# CONFIG_BT_HCIUART_MRVL is not set
CONFIG_BT_HCIBCM203X=m
CONFIG_BT_HCIBPA10X=m
# CONFIG_BT_HCIBFUSB is not set
CONFIG_BT_HCIVHCI=m
# IWD
CONFIG_ASYMMETRIC_KEY_TYPE=y                              
CONFIG_ASYMMETRIC_PUBLIC_KEY_SUBTYPE=y                    
CONFIG_CRYPTO_AES=y                                       
CONFIG_CRYPTO_ARC4=y                                      
CONFIG_CRYPTO_CBC=y                                       
CONFIG_CRYPTO_CMAC=y                                      
CONFIG_CRYPTO_DES=y                                       
CONFIG_CRYPTO_ECB=y                                       
CONFIG_CRYPTO_HMAC=y                                      
CONFIG_CRYPTO_MD5=y                                       
CONFIG_CRYPTO_SHA1=y                                      
CONFIG_CRYPTO_SHA256=y                                    
CONFIG_CRYPTO_SHA512=y                                    
CONFIG_CRYPTO_USER_API_HASH=y                             
CONFIG_CRYPTO_USER_API_SKCIPHER=y                         
CONFIG_KEY_DH_OPERATIONS=y                                
CONFIG_PKCS7_MESSAGE_PARSER=y                             
CONFIG_PKCS8_PRIVATE_KEY_PARSER=y                         
CONFIG_X509_CERTIFICATE_PARSER=y                          
```

## wic/orange-pi.wks
```
part uboot --source rawcopy --sourceparams="file=u-boot-sunxi-with-spl.bin" --ondisk mmcblk --no-table --align 8
part /boot --source bootimg-partition --ondisk mmcblk0 --fstype=vfat --label boot --active --align 4096
part / --source rootfs --ondisk mmcblk0 --fstype=ext4 --label root --align 4096
```

## wic/sun50i.wks
```
part SPL --source rawcopy --sourceparams="file=sunxi-spl.bin" --ondisk mmcblk --no-table --align 8
part uboot --source rawcopy --sourceparams="file=u-boot.itb" --ondisk mmcblk --no-table --align 40
part /boot --source bootimg-partition --ondisk mmcblk0 --fstype=vfat --label boot --active --align 2048
part / --source rootfs --ondisk mmcblk0 --fstype=ext4 --label root --align 1024
```
